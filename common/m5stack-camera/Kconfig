## common/m5stack-camera/Kconfig
```kconfig
menu "M5 Camera Model Select"

    choice M5_CAMERA_MODEL
        prompt "Select M5 Camera Model"
        default TIMER_CAMERA_X_F
        help
            Select which M5 Camera model to use

        config M5_CAMERA_X_F
            bool "M5 Camera X/F"
            help
                M5 Camera X/F model

        config TIMER_CAMERA_X_F
            bool "Timer Camera X/F"
            help
                Timer Camera X/F model

        config UNIT_CAM
            bool "Unit Cam"
            help
                Unit Cam model

    endchoice

endmenu
```

## idf/http-stream/sdkconfig.defaults
```kconfig
CONFIG_ESP32_DEFAULT_CPU_FREQ_240=y
CONFIG_ESP32S2_DEFAULT_CPU_FREQ_240=y
CONFIG_ESP32S3_DEFAULT_CPU_FREQ_240=y

CONFIG_ESPTOOLPY_FLASHSIZE_4MB=y
CONFIG_PARTITION_TABLE_OFFSET=0x10000

CONFIG_FREERTOS_HZ=1000
CONFIG_ESPTOOLPY_FLASHFREQ_80M=y
CONFIG_ESPTOOLPY_FLASHMODE_QIO=y

CONFIG_SPIRAM_SUPPORT=y
CONFIG_ESP32_SPIRAM_SUPPORT=y
CONFIG_ESP32S2_SPIRAM_SUPPORT=y
CONFIG_ESP32S3_SPIRAM_SUPPORT=y
CONFIG_SPIRAM_SPEED_80M=y


CONFIG_HAVE_I2C_MANAGER=y
CONFIG_I2C_MANAGER_0_ENABLED=y
CONFIG_I2C_MANAGER_0_SDA=12
CONFIG_I2C_MANAGER_0_SCL=14
CONFIG_I2C_MANAGER_0_FREQ_HZ=400000
CONFIG_I2C_MANAGER_0_TIMEOUT=20
CONFIG_I2C_MANAGER_0_LOCK_TIMEOUT=50
CONFIG_I2C_MANAGER_I2CDEV=y
```
